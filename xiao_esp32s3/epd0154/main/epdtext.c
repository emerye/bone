
#include <stdio.h>
#include <string.h>
#include "freertos/FreeRTOS.h"
#include "freertos/task.h"
#include "driver/spi_master.h"
#include "driver/gpio.h"
#include "esp_log.h"
#include "goog_64x32.h"

static const char *TAG = "EPD_MAIN";

// XIAO ESP32S3 Pin Definitions
#define EPD_MOSI_PIN     9
#define EPD_SCLK_PIN     7
#define EPD_CS_PIN       3
#define EPD_DC_PIN       4
#define EPD_RST_PIN      5
#define EPD_BUSY_PIN     6

// Display dimensions 
#define EPD_WIDTH        200
#define EPD_HEIGHT       200
#define BUFFER_SIZE      ((EPD_WIDTH * EPD_HEIGHT) / 8)

static spi_device_handle_t spi_handle;
static uint8_t image_buffer[BUFFER_SIZE];


// 8x8 Monochrome ASCII Font (0x20 to 0x7E)
static const uint8_t font8x8[][8] = {
    {0x00,0x00,0x00,0x00,0x00,0x00,0x00,0x00}, // space
    {0x18,0x3C,0x3C,0x18,0x18,0x00,0x18,0x00}, // !
    {0x6C,0x6C,0x6C,0x00,0x00,0x00,0x00,0x00}, // "
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    {0x76,0xDC,0x00,0x00,0x00,0x00,0x00,0x00}  // ~
};

// Low-Level SPI Operations
void epd_write_command(uint8_t command) {  
    gpio_set_level(EPD_DC_PIN, 0);
    spi_transaction_t t = { .length = 8, .tx_buffer = &command };
    spi_device_polling_transmit(spi_handle, &t);
}

void epd_write_data(uint8_t data) {
    gpio_set_level(EPD_DC_PIN, 1);
    spi_transaction_t t = { .length = 8, .tx_buffer = &data };
    spi_device_polling_transmit(spi_handle, &t);
}

void epd_wait_busy(void) {
    while (gpio_get_level(EPD_BUSY_PIN) == 1) {
        vTaskDelay(pdMS_TO_TICKS(10));
    }
}

// Driver Hardware Configurations
void epd_init(void) {
    gpio_set_level(EPD_RST_PIN, 0);
    vTaskDelay(pdMS_TO_TICKS(20));
    gpio_set_level(EPD_RST_PIN, 1);
    vTaskDelay(pdMS_TO_TICKS(20));
    epd_wait_busy();

    // SW Reset
    epd_write_command(0x12);
    epd_wait_busy();

    // Driver Output control
    epd_write_command(0x01);
    epd_write_data((EPD_HEIGHT - 1) & 0xFF);
    epd_write_data(((EPD_HEIGHT - 1) >> 8) & 0xFF);
    epd_write_data(0x00);

    // Data Entry Mode
    epd_write_command(0x11);
    epd_write_data(0x03);

    // RAM X Position Settings
    epd_write_command(0x44);
    epd_write_data(0x00);
    epd_write_data((EPD_WIDTH / 8) - 1);

    // RAM Y Position Settings
    epd_write_command(0x45);
    epd_write_data(0x00);
    epd_write_data(0x00);
    epd_write_data((EPD_HEIGHT - 1) & 0xFF);
    epd_write_data(((EPD_HEIGHT - 1) >> 8) & 0xFF);

    // Border Waveform Setup
    epd_write_command(0x3C);
    epd_write_data(0x05);

    // Update Mode Options
    epd_write_command(0x22);
    epd_write_data(0x91);
    epd_write_command(0x20);
    epd_wait_busy();
}

void epd_display_frame(const uint8_t *buffer) {
    // Reset RAM Counters
    epd_write_command(0x4E);
    epd_write_data(0x00);
    epd_write_command(0x4F);
    epd_write_data(0x00);
    epd_write_data(0x00);

    // Flush Memory Bus Bytes
    epd_write_command(0x24);
    for (int i = 0; i < BUFFER_SIZE; i++) {
        epd_write_data(buffer[i]);
    }

    // Refresh display
    epd_write_command(0x22);
    epd_write_data(0xF7);
    epd_write_command(0x20);
    epd_wait_busy();
}

void epd_sleep(void) {
    epd_write_command(0x10);
    epd_write_data(0x01);
}

// Canvas Painting Operations
void draw_pixel(int x, int y, uint8_t color) {
    if (x < 0 || x >= EPD_WIDTH || y < 0 || y >= EPD_HEIGHT) return;
    int index = (x / 8) + (y * (EPD_WIDTH / 8));
    uint8_t bit_mask = (0x80 >> (x % 8));
    if (color == 0) {
        image_buffer[index] &= ~bit_mask;
    } else {
        image_buffer[index] |= bit_mask;
    }
}

void draw_rectangle(int x1, int y1, int x2, int y2, uint8_t color) {
    for (int x = x1; x <= x2; x++) {
        draw_pixel(x, y1, color);
        draw_pixel(x, y2, color);
    }
    for (int y = y1; y <= y2; y++) {
        draw_pixel(x1, y, color);
        draw_pixel(x2, y, color);
    }
}

void draw_char(int x, int y, char c, uint8_t color, int size) {
    if (c < 32 || c > 126) return;
    int font_idx = c - 32;


    for (int row = 0; row < 8; row++) {
        uint8_t row_data = font8x8[font_idx][row];
        for (int col = 0; col < 8; col++) {
            if (row_data & (0x80 >> col)) {
                for (int sx = 0; sx < size; sx++) {
                    for (int sy = 0; sy < size; sy++) {
                        int target_x = x + (col * size) + sx;
                        int target_y = y + (row * size) + sy;
                        draw_pixel(target_x, target_y, color);
                    }
                }
            }
        }
    }
}

void draw_string(int x, int y, const char *str, uint8_t color, int size) {
    while (*str) {
        draw_char(x, y, *str, color, size);
        x += 8 * size;
        str++;
    }
}


// --- Graphical Utilities Supporting the "font_bitmap_64px" Array ---

// Renders a single 32x64 clock symbol from the font_bitmap_64px array
void draw_clock_char(int x, int y, char c, uint8_t color) {
    int idx = -1;

    // Map characters to array indices: digits 0-9 match indices 0-9, colon is 10
    if (c >= '0' && c <= '9') {
        idx = c - '0';
    } else if (c == ':') {
        idx = 10;
    }

    // Abort if the character is outside our custom font map range
    if (idx == -1) return;

    for (int row = 0; row < 64; row++) {
        for (int byte_col = 0; byte_col < 4; byte_col++) {
            // Unpack 4 bytes sequentially to cover 32 horizontal pixels per row
            // Indexing format: [character_index][row_byte_offset]
            uint8_t byte_data = font_bitmap_64px[(idx * 256) + (row * 4) + byte_col];

            for (int bit = 0; bit < 8; bit++) {
                if (byte_data & (0x80 >> bit)) {
                    int target_x = x + (byte_col * 8) + bit;
                    int target_y = y + row;
                    draw_pixel(target_x, target_y, color);
                }
            }
        }
    }
}


// Iterates through string arrays to pass structured character layouts to the canvas

void draw_clock_string(int x, int y, const char *str, uint8_t color) {
    while (*str) {
        draw_clock_char(x, y, *str, color);
        // Step forward by exactly 32 horizontal pixels for the next clock element
        x += 32;
        str++;
    }
}


// Renders a single 16x32 clock font symbol
/*
void draw_clock_char(int x, int y, char c, uint8_t color) {
    int idx = -1;

    // Convert character to our targeted array index lookup
    if (c >= '0' && c <= '9') {
        idx = c - '0';
    } else if (c == ':') {
        idx = 10;
    }

    if (idx == -1) return; // Ignore unmapped characters

    for (int row = 0; row < 32; row++) {
        // Read 2 bytes tracking 16 horizontal pixels across the current row
        uint8_t byte1 = font16x32[idx][row * 2];
        uint8_t byte2 = font16x32[idx][row * 2 + 1];

        // Process first byte (Left 8 pixels)
        for (int col = 0; col < 8; col++) {
            if (byte1 & (0x80 >> col)) {
                draw_pixel(x + col, y + row, color);
            }
        }
        // Process second byte (Right 8 pixels)
        for (int col = 0; col < 8; col++) {
            if (byte2 & (0x80 >> col)) {
                draw_pixel(x + 8 + col, y + row, color);
            }
        }
    }
}

*/


// Loops string characters across screen matrices 32 bit font
/*
void draw_clock_string(int x, int y, const char *str, uint8_t color) {
    while (*str) {
        draw_clock_char(x, y, *str, color);
        // Step forward by 16 horizontal pixels for the next clock element
        x += 16; 
        str++;
    }
}
*/

// System Startup Location
void app_main(void)
{
    ESP_LOGI(TAG, "Starting up...");

    // Setup control lines
    gpio_config_t io_conf = {
        .pin_bit_mask = (1ULL << EPD_DC_PIN) | (1ULL << EPD_RST_PIN),
        .mode = GPIO_MODE_OUTPUT,
    };
    gpio_config(&io_conf);

    // Setup feedback input
    gpio_config_t input_conf = {
        .pin_bit_mask = (1ULL << EPD_BUSY_PIN),
        .mode = GPIO_MODE_INPUT,
        .pull_up_en = GPIO_PULLUP_ENABLE,
    };
    gpio_config(&input_conf);

    // Setup SPI Configuration
    spi_bus_config_t buscfg = {
        .mosi_io_num = EPD_MOSI_PIN,
        .miso_io_num = -1,
        .sclk_io_num = EPD_SCLK_PIN,
        .quadwp_io_num = -1,
        .quadhd_io_num = -1,
        .max_transfer_sz = BUFFER_SIZE};
    spi_device_interface_config_t devcfg = {
        .clock_speed_hz = 4 * 1000 * 1000,
        .mode = 0,
        .spics_io_num = EPD_CS_PIN,
        .queue_size = 1,
        .flags = SPI_DEVICE_HALFDUPLEX};
    ESP_ERROR_CHECK(spi_bus_initialize(SPI2_HOST, &buscfg, SPI_DMA_CH_AUTO));
    ESP_ERROR_CHECK(spi_bus_add_device(SPI2_HOST, &devcfg, &spi_handle));
    // Fill screen buffer with White baseline (0xFF)
    memset(image_buffer, 0xFF, sizeof(image_buffer));
    // Outer framing box
    draw_rectangle(15, 15, 185, 185, 0);
    // Display centered text

    //draw_string(20, 90, "Hello World", 0, 2);
    //draw_string(20, 110, "Hello There", 0, 2);

     draw_clock_string(20, 68, "1", 0);


    // Hardware Push Initialization Sequence
    epd_init();
    ESP_LOGI(TAG, "Writing text frame to panel...");
    epd_display_frame(image_buffer);
    // Put controller to deep sleep
    ESP_LOGI(TAG, "Entering panel deep sleep state.");
    epd_sleep();
}
